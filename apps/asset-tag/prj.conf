## CMakeLists.txt
```
# SPDX-License-Identifier: Apache-2.0

cmake_minimum_required(VERSION 3.13.1)
find_package(Zephyr REQUIRED HINTS $ENV{ZEPHYR_BASE})
project(ble_app)
set(CMAKE_EXPORT_COMPILE_COMMANDS ON)

include_directories(AFTER include)
FILE(GLOB app_sources src/*.c src/*.cpp)
target_sources(app PRIVATE
  ${app_sources}
  )
```

## prj.conf
```kconfig
# basic/button
CONFIG_GPIO=y

# bluetooth/peripheral_hr
CONFIG_BT=y
CONFIG_BT_HCI=y
CONFIG_BT_CTLR=y
CONFIG_BT_LL_SW_SPLIT=y

CONFIG_BT_PERIPHERAL=y
CONFIG_BT_SMP=y
CONFIG_BT_GATT_DIS_PNP=n
CONFIG_BT_GATT_BAS=y
CONFIG_BT_DEVICE_NAME="QSIB_ASSET"
CONFIG_BT_DEVICE_APPEARANCE=833

# nrf/battery
CONFIG_ADC=y
CONFIG_NRFX_SAADC=y

# mcumgr/smp_svr
# * Enable mcumgr.
CONFIG_MCUMGR=y
CONFIG_SHELL=n

# * Some command handlers require a large stack.
# CONFIG_SYSTEM_WORKQUEUE_STACK_SIZE=2048

# * Ensure an MCUboot-compatible binary is generated.
CONFIG_BOOTLOADER_MCUBOOT=y

# * Allow for large Bluetooth data packets.
CONFIG_BT_L2CAP_TX_MTU=260
CONFIG_BT_RX_BUF_LEN=260

# * Enable the Bluetooth (unauthenticated) and shell mcumgr transports.
CONFIG_MCUMGR_SMP_BT=y
CONFIG_MCUMGR_SMP_BT_AUTHEN=n
CONFIG_MCUMGR_SMP_SHELL=n
CONFIG_MCUMGR_SMP_UART=n

# * Enable flash operations.
CONFIG_FLASH=y

# * Enable the LittleFS file system.
CONFIG_FILE_SYSTEM=y
CONFIG_FILE_SYSTEM_LITTLEFS=y

# * Required by the `taskstat` command.
CONFIG_THREAD_MONITOR=n

# * Enable statistics and statistic names.
CONFIG_STATS=n
CONFIG_STATS_NAMES=n

# * Enable all core commands.
CONFIG_MCUMGR_CMD_FS_MGMT=y
CONFIG_MCUMGR_CMD_IMG_MGMT=y
CONFIG_MCUMGR_CMD_OS_MGMT=y
CONFIG_MCUMGR_CMD_STAT_MGMT=n

# skin-hydration
CONFIG_CPLUSPLUS=y
CONFIG_STD_CPP17=y
CONFIG_LIB_CPLUSPLUS=y
CONFIG_EXCEPTIONS=y

CONFIG_CONSOLE=n
CONFIG_LOG=y
CONFIG_LOG_BACKEND_RTT=y
CONFIG_USE_SEGGER_RTT=y

CONFIG_SERIAL=n
CONFIG_UART_CONSOLE=n
CONFIG_PRINTK=n

CONFIG_REBOOT=y
CONFIG_NEWLIB_LIBC=y

# CONFIG_SYSTEM_WORKQUEUE_PRIORITY=-2
CONFIG_SYSTEM_WORKQUEUE_STACK_SIZE=4096
CONFIG_BT_CONN_TX_MAX=16
CONFIG_BT_L2CAP_TX_BUF_COUNT=16
CONFIG_BT_DEBUG_CONN=n
```

## src/main.cpp
```c
#include <app_log.hpp>
#include <app_exception.hpp>
#include <app_gpio.hpp>
#include <app_ble.hpp>
#include <app_saadc.hpp>

/**
 * Asset tag life cycle
 * 
 * 1. Advertise
 * 2. Connect
 * 3. Wait for characteristics writes or disconnect 
 * 4. Sleep configured amount of time
 */ 

PREPARE_GPIO(led0);

void main(void) {
	LOG_INF("Beginning main() ...");

	// Prepare hardware components/peripherals
	std::tuple<app_gpio::pin_t&, uint32_t> led0(led0_gpio, GPIO_OUTPUT_ACTIVE);
	app_gpio::manager_t gpio_manager(std::move(led0));

	// Prepare ble structures
	app_ble::manager_t ble_manager;

	// Handle lifecycle
	bool led_is_on = true;
	while (1) {
		led0_gpio.set(led_is_on);
		led_is_on = !led_is_on;
		LOG_INF("LED is on: %d", (int) led_is_on);

		app_saadc::measure();

		k_sleep(k_timeout_t{K_SECONDS(1)});
	}
}
```

## include/app_battery.hpp
```c
#ifndef APP_INCLUDE_APP_BATTERY_HPP
#define APP_INCLUDE_APP_BATTERY_HPP


/** A point in a battery discharge curve sequence.
 *
 * A discharge curve is defined as a sequence of these points, where
 * the first point has #lvl_pct set to 10000 and the last point has
 * #lvl_pct set to zero.  Both #lvl_pct and #lvl_mV should be
 * monotonic decreasing within the sequence.
 */
struct battery_level_point {
        /** Remaining life at #lvl_mV. */
        uint16_t lvl_pct;

        /** Battery voltage at #lvl_pct remaining life. */
        uint16_t lvl_mV;
};

/** A discharge curve specific to the power source. */
static const struct battery_level_point levels[] = {
        /* Linear from maximum voltage to minimum voltage. */
        { 100, 3300 },
        { 0, 2600 }, // Powered by mac gives 2.8V
};

/** Calculate the estimated battery level based on a measured voltage.
 *
 * @param batt_mV a measured battery voltage level.
 *
 * @param curve the discharge curve for the type of battery installed
 * on the system.
 *
 * @return the estimated remaining capacity in parts per ten
 * thousand.
 */
unsigned int battery_level_pct(unsigned int batt_mV) {
	const struct battery_level_point *pb = levels;

	if (batt_mV >= pb->lvl_mV) {
		/* Measured voltage above highest point, cap at maximum. */
		return pb->lvl_pct;
	}
	/* Go down to the last point at or below the measured voltage. */
	while ((pb->lvl_pct > 0)
	       && (batt_mV < pb->lvl_mV)) {
		++pb;
	}
	if (batt_mV < pb->lvl_mV) {
		/* Below lowest point, cap at minimum */
		return pb->lvl_pct;
	}

	/* Linear interpolation between below and above points. */
	const struct battery_level_point *pa = pb - 1;

	return pb->lvl_pct + ((pa->lvl_pct - pb->lvl_pct) * (batt_mV - pb->lvl_mV) / (pa->lvl_mV - pb->lvl_mV));
}

#endif
```

## include/app_ble.hpp
```c
#ifndef APP_INCLUDE_APP_BLE_HPP
#define APP_INCLUDE_APP_BLE_HPP

#include <app_log.hpp>
#include <app_smp.hpp>

#include <zephyr.h>
#include <bluetooth/bluetooth.h>
#include <bluetooth/hci.h>
#include <bluetooth/conn.h>
#include <bluetooth/uuid.h>
#include <bluetooth/gatt.h>
#include <bluetooth/services/bas.h>

#include <stdexcept>

namespace app_ble {
    static constexpr bt_data advertisement_data[] = {
        BT_DATA_BYTES(BT_DATA_FLAGS, (BT_LE_AD_GENERAL | BT_LE_AD_NO_BREDR)),
        BT_DATA_BYTES(BT_DATA_UUID16_ALL, 0x0f, 0x18),
        BT_DATA_BYTES(BT_DATA_UUID128_ALL, BT_UUID_SMP_DATA_BYTES)
    };

    static bt_le_adv_param adv_params[] = {
        BT_LE_ADV_PARAM_INIT(
            BT_LE_ADV_OPT_CONNECTABLE |  BT_LE_ADV_OPT_USE_NAME,
            BT_GAP_ADV_FAST_INT_MIN_2,
            BT_GAP_ADV_FAST_INT_MAX_2,
            NULL)
        };

    struct static_manager_t {
        static void bt_adv() {
            bt_le_adv_stop();
            const auto err = bt_le_adv_start(adv_params, advertisement_data, ARRAY_SIZE(advertisement_data), NULL, 0);
            if (err) {
                LOG_ERR("Advertising failed to start (err %d)", err);
                throw std::runtime_error("Failed to start advertising");
            }

            LOG_DBG("Advertising successfully started");
        }

        static void connected(bt_conn *conn, uint8_t err) {
            bt_le_adv_stop();

            if (err) {
                LOG_INF("Connection failed (err 0x%02x)", err);
                bt_adv();
            } else {
                LOG_INF("Connected");
            }
        }

        static void disconnected(bt_conn *conn, uint8_t reason) {
            LOG_INF("Disconnected (reason 0x%02x)", reason);
            bt_adv();
        }
    };

    static bt_conn_cb conn_callbacks = {
        .connected = static_manager_t::connected,
        .disconnected = static_manager_t::disconnected,
    };

    struct manager_t {
        manager_t() {
            int ret;

            // Register the built-in mcumgr command handlers before advertising */
            #ifdef CONFIG_MCUMGR_CMD_FS_MGMT
                ret = fs_mount(&littlefs_mnt);
                if (ret < 0) {
                    LOG_ERR("Error mounting littlefs: %d", ret);
                    throw std::runtime_error("Failed to mount littlefs");
                }

                fs_mgmt_register_group();
            #endif
            #ifdef CONFIG_MCUMGR_CMD_OS_MGMT
                os_mgmt_register_group();
            #endif
            #ifdef CONFIG_MCUMGR_CMD_IMG_MGMT
                img_mgmt_register_group();
            #endif
            #ifdef CONFIG_MCUMGR_CMD_STAT_MGMT
                stat_mgmt_register_group();
            #endif

            // Prepare kernel structures
            ret = bt_enable(NULL);
            if(ret) {
                LOG_ERR("Failed to enable bluetooth: %d", ret);
                throw std::runtime_error("Failed to enable bluetooth");
            }
            LOG_DBG("Bluetooth initialized");
            
            // Register advertisement and callback configurations
            bt_conn_cb_register(&conn_callbacks);
            smp_bt_register();
            static_manager_t::bt_adv();
        }
    };
}


#endif
```

## include/app_exception.hpp
```c
#ifndef APP_INCLUDE_APP_EXCEPTION_HPP
#define APP_INCLUDE_APP_EXCEPTION_HPP

#include <app_log.hpp>

#include <zephyr.h>

#include <stdexcept>


[[noreturn]] void terminate() noexcept {
	LOG_ERR("Failed with exception");
	while(log_process(false) || true) {
		k_sleep(K_SECONDS(1));
	}
	abort();
}

namespace __cxxabiv1 {
	std::terminate_handler __terminate_handler = terminate;
}


#endif
```

## include/app_gpio.hpp
```c
#ifndef APP_INCLUDE_GPIO_HPP
#define APP_INCLUDE_GPIO_HPP

#include <app_log.hpp>

#include <zephyr.h>
#include <device.h>
#include <devicetree.h>
#include <drivers/gpio.h>

#include <array>
#include <cstring>
#include <stdexcept>
#include <string_view>
#include <tuple>

namespace app_gpio {

struct pin_t {
    std::string_view label;
    uint32_t pin;
    uint32_t flags;
    device*  device_binding;

    explicit constexpr pin_t(bool status_okay, std::string_view label, uint32_t pin, uint32_t flags) 
    : label(label), pin(pin), flags(flags), device_binding(nullptr) {
        if(!status_okay) {
            std::string_view message_begin = "Invalid label: ";
            char message[message_begin.size() + label.size()] = {};
            std::memcpy(message, message_begin.begin(), message_begin.size());
            std::memcpy(message + message_begin.size(), label.begin(), label.size());
            throw std::logic_error(message);
        }

    }

    void configure(uint32_t extra_flags) {
        LOG_DBG("Configuring %s on %d", label.data(), pin);
        device_binding = device_get_binding(label.data());
        if(gpio_pin_configure(device_binding, pin, extra_flags | flags)) {
            throw std::runtime_error("Failed to configure gpio");
        }
    }

    void set(int value) {
        gpio_pin_set(device_binding, pin, value);
    }
};

template<typename ... T>
struct manager_t {
    std::array<std::tuple<pin_t&, uint32_t>, sizeof...(T)> pin_confs;

    explicit constexpr manager_t(T&& ... pin_conf_args) 
        : pin_confs({std::forward<T...>(pin_conf_args...)}) {
        for(auto & [pin, flags] : pin_confs) {
            pin.configure(flags);
        }
    }
};

using namespace std::literals;

#define PREPARE_GPIO(label) struct label ## _binding_t { \
    static constexpr bool             status_okay = DT_NODE_HAS_STATUS(DT_ALIAS(label), okay); \
    static constexpr std::string_view label       = DT_GPIO_LABEL(DT_ALIAS(label), gpios) "\0"; \
    static constexpr const uint32_t   pin         = DT_GPIO_PIN(DT_ALIAS(label), gpios); \
    static constexpr const uint32_t   flags       = DT_GPIO_FLAGS(DT_ALIAS(label), gpios); \
}; \
app_gpio::pin_t label ## _gpio( \
    label ## _binding_t::status_okay, \
    label ## _binding_t::label, \
    label ## _binding_t::pin, \
    label ## _binding_t::flags);

}


#endif
```

## include/app_led.hpp
```c
#ifndef APP_INCLUDE_LED_H
#define APP_INCLUDE_LED_H

#include <zephyr.h>
#include <device.h>
#include <devicetree.h>
#include <drivers/gpio.h>

#include <string_view>
#include <stdexcept>


struct gpio_t {
    std::string_view label;
    uint32_t pin;
    uint32_t flags;
    device*  device_binding;

    explicit constexpr gpio_t(bool status_okay, std::string_view label, uint32_t pin, uint32_t flags) 
    : label(label), pin(pin), flags(flags), device_binding(nullptr) {
        if(!status_okay) {
            std::string_view message_begin = "Invalid label: ";
            char message[message_begin.size() + label.size()] = {};
            memcpy(message, message_begin.begin(), message_begin.size());
            memcpy(message + message_begin.size(), label.begin(), label.size());
            throw std::logic_error(message);
        }

    }

    void configure(uint32_t extra_flags) {
        device_binding = device_get_binding(label.data());
        if(gpio_pin_configure(device_binding, pin, extra_flags | flags)) {
            throw std::runtime_error("Failed to configure gpio");
        }
    }

    void set(int value) {
        gpio_pin_set(device_binding, pin, value);
    }
};

using namespace std::literals;

#define PREPARE_GPIO(label) struct label ## _binding_t { \
    static constexpr bool             status_okay = DT_NODE_HAS_STATUS(DT_ALIAS(label), okay); \
    static constexpr std::string_view label       = DT_GPIO_LABEL(DT_ALIAS(label), gpios) "\0"; \
    static constexpr const uint32_t   pin         = DT_GPIO_PIN(DT_ALIAS(label), gpios); \
    static constexpr const uint32_t   flags       = DT_GPIO_FLAGS(DT_ALIAS(label), gpios); \
}; \
gpio_t label ## _gpio( \
    label ## _binding_t::status_okay, \
    label ## _binding_t::label, \
    label ## _binding_t::pin, \
    label ## _binding_t::flags);


#endif
```

## include/app_log.hpp
```c
#ifndef APP_INCLUDE_APP_LOG_HPP
#define APP_INCLUDE_APP_LOG_HPP

#define LOG_LEVEL LOG_LEVEL_DBG
#define LOG_MODULE_NAME ble_app
#include <logging/log.h>
#include <logging/log_ctrl.h>
LOG_MODULE_REGISTER(LOG_MODULE_NAME, LOG_LEVEL);

#endif
```

## include/app_saadc.hpp
```c
#ifndef APP_INCLUDE_APP_SAADC_HPP
#define APP_INCLUDE_APP_SAADC_HPP

#include <app_battery.hpp>
#include <app_log.hpp>

#include <zephyr.h>
#include <device.h>
#include <drivers/adc.h>
#include <drivers/sensor.h>

#include <hal/nrf_gpio.h>
#include <hal/nrf_saadc.h>

#include <cstring>
#include <stdexcept>

namespace app_saadc {

	static constexpr const uint16_t ADC_ACQUISITION_TIME = ADC_ACQ_TIME(ADC_ACQ_TIME_MICROSECONDS, 10);

	static constexpr uint32_t SAMPLES_IN_BUFFER = 1;
	static int16_t sample_buffer[SAMPLES_IN_BUFFER];

	void measure() {
		static device* adc_device = device_get_binding(DT_LABEL(DT_INST(0, nordic_nrf_saadc)));

		const adc_channel_cfg vdd_channel_cfg = {
			.gain             = ADC_GAIN_1_6,
			.reference        = ADC_REF_INTERNAL,
			.acquisition_time = ADC_ACQUISITION_TIME,
			.channel_id       = 0,
			.input_positive   = NRF_SAADC_INPUT_VDD
		};

		const adc_channel_cfg* cfgs[] = {
			&vdd_channel_cfg, 
		};
		
		const int num_channels = sizeof(cfgs) / sizeof(struct adc_channel_cfg*);
		uint8_t channels = 0;
		int ret;
		for(int i = 0; i < num_channels; i++) {
			// LOG_DBG("Channel: %d on PinP: %d PinN: %d", (int32_t) cfgs[i]->channel_id, (int32_t) cfgs[i]->input_positive, (int32_t) cfgs[i]->input_negative);
			channels |= BIT(cfgs[i]->channel_id);
			ret = adc_channel_setup(adc_device, cfgs[i]);
			if(ret) {
				LOG_ERR("Failed to register channel config for %d", i);
				throw std::runtime_error("Failed to register channel");
			}
		}

		// Initiate the saadc sequence
		std::memset(sample_buffer, 0, sizeof(sample_buffer));
		const struct adc_sequence sequence = {
			.channels    = channels,
			.buffer      = sample_buffer,
			.buffer_size = sizeof(sample_buffer),
			.resolution  = 12,
		};
		ret = adc_read(adc_device, &sequence);
		if(ret) {
			LOG_ERR("Failed to do an adc_read: %d", ret);
			throw std::runtime_error("Failed to do adc_read");
		}

		// Convert the samples to meaningful scale (mV)
		for(int i = 0; i < num_channels; i++) {
			int32_t value = sample_buffer[i];
			ret = adc_raw_to_millivolts(adc_ref_internal(adc_device),
								cfgs[i]->gain,
								sequence.resolution,
								&value);
			// LOG_DBG("Channel: %" PRId32" Before: %" PRId32 " After: %" PRId32, cfgs[i]->channel_id, before_value, value);
			if (ret) {
				printk("Failed to convert adc raw to millivolts: ret %d", ret);
				throw std::runtime_error("Failed to convert adc");
			}

			if(i == 0) {
				uint8_t pct = battery_level_pct(value);
				LOG_DBG("VDD: %d mV (%d pct)", value, (int32_t) pct);
				bt_gatt_bas_set_battery_level(pct);
			} else {
				throw std::runtime_error("Unexpected channel sample! Programming error");
			}
		}
	}
}

#endif
```

## include/app_smp.hpp
```c
#ifndef APP_INCLUDE_APP_SMP_HPP
#define APP_INCLUDE_APP_SMP_HPP

#include <zephyr.h>
#include <string.h>
#include <stdlib.h>
#include <stats/stats.h>
#include <mgmt/buf.h>

#ifdef CONFIG_MCUMGR_CMD_FS_MGMT
#include <device.h>
#include <fs/fs.h>
#include "fs_mgmt/fs_mgmt.h"
#include <fs/littlefs.h>
#endif
#ifdef CONFIG_MCUMGR_CMD_OS_MGMT
#include "os_mgmt/os_mgmt.h"
#endif
#ifdef CONFIG_MCUMGR_CMD_IMG_MGMT
#include "img_mgmt/img_mgmt.h"
#endif
#ifdef CONFIG_MCUMGR_CMD_STAT_MGMT
#include "stat_mgmt/stat_mgmt.h"
#endif

#ifdef CONFIG_MCUMGR_SMP_BT
#include <bluetooth/bluetooth.h>
#include <bluetooth/conn.h>
#include <bluetooth/gatt.h>
#include <mgmt/smp_bt.h>
#endif

#ifdef CONFIG_MCUMGR_CMD_FS_MGMT
FS_LITTLEFS_DECLARE_DEFAULT_CONFIG(cstorage);
static fs_mount_t littlefs_mnt = {
	.type = FS_LITTLEFS,
	.mnt_point = "/lfs",
	.fs_data = &cstorage,
	.storage_dev = (void *)FLASH_AREA_ID(storage),
};
#endif

#ifdef CONFIG_MCUMGR_SMP_BT
#define BT_UUID_SMP_DATA_BYTES 0x84, 0xaa, 0x60, 0x74, 0x52, 0x8a, 0x8b, 0x86, 0xd3, 0x4c, 0xb7, 0x1d, 0x1d, 0xdc, 0x53, 0x8d
#endif



#endif
```
